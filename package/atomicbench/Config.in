## package/atomicbench/Config.in
```kconfig
config BR2_PACKAGE_ATOMICBENCH
 bool "atomicbench"
 help
  AtomicBench is a benchmark that measures the performance of
  SMP CPU used in C11/C11++ atomic interface

  https://github.com/plctlab/atomic_benchmark/
```

## package/go-ci/Config.in
```kconfig
config BR2_PACKAGE_GO_CI
	bool "go ci test"
	default y
	depends on BR2_RISCV_64
	help
	  base on buildroot GO CI test

comment "go ci need host go bootstrap supports"
	depends on !BR2_RISCV_64
```

## package/litmus-test/Config.in
```kconfig
config BR2_PACKAGE_LITMUS_TEST
	bool "riscv litmus test"
	depends on BR2_riscv
	depends on BR2_PACKAGE_HOST_HERDTOOLS7
	help
	  The tests can also be used for memroy order test.

	  https://github.com/litmus-tests/litmus-tests-riscv

comment "riscv litmus test needs herdtools7"
	depends on  !BR2_PACKAGE_HOST_HERDTOOLS7
```

## package/pts-ci/Config.in
```kconfig
config BR2_PACKAGE_PTS_CI
	bool "pts-ci"
	depends on BR2_PACKAGE_CSKY_CI
	select BR2_PACKAGE_ATOMICBENCH
```
